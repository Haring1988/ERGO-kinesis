## config/boards/shields/ERGO-kinesis/Kconfig.shield
```kconfig
# Copyright (c) 2020 The ZMK Contributors
# SPDX-License-Identifier: MIT

config SHIELD_ERGO-kinesis_CENTRAL_DONGLE
    def_bool $(shields_list_contains,ERGO-kinesis_central_dongle)

config SHIELD_ERGO-kinesis_CENTRAL_LEFT
    def_bool $(shields_list_contains,ERGO-kinesis_central_left)
    
config SHIELD_ERGO-kinesis_PERIPHERAL_LEFT
    def_bool $(shields_list_contains,ERGO-kinesis_peripheral_left)

config SHIELD_ERGO-kinesis_PERIPHERAL_RIGHT
    def_bool $(shields_list_contains,ERGO-kinesis_peripheral_right)
```
